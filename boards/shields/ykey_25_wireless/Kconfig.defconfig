## boards/shields/ykey_25_wireless/Kconfig.defconfig
```kconfig
if SHIELD_YKEY_25_WIRELESS_LEFT

config ZMK_KEYBOARD_NAME
    default "ykey_25_wireless"

endif

if SHIELD_YKEY_25_WIRELESS_LEFT || SHIELD_YKEY_25_WIRELESS_RIGHT

config ZMK_SPLIT
    default y

endif
```

## boards/shields/ykey_25_wireless/Kconfig.shield
```kconfig
config SHIELD_YKEY_25_WIRELESS_LEFT
    def_bool $(shields_list_contains,ykey_25_wireless_left)
config SHIELD_YKEY_25_WIRELESS_RIGHT
    def_bool $(shields_list_contains,ykey_25_wireless_right)
```
